## config/west.yml
```yaml
manifest:
  remotes:
    - name: zmkfirmware
      url-base: https://github.com/zmkfirmware
    - name: inorichi       # ◀︎ inorichi に戻します！
      url-base: https://github.com/inorichi
    - name: caksoylar
      url-base: https://github.com/caksoylar
    - name: 4mplelab
      url-base: https://github.com/4mplelab
  projects:
    - name: zmk
      remote: zmkfirmware
      revision: v0.3
      import: app/west.yml
    - name: zmk-pmw3610-driver
      remote: inorichi     # ◀︎ inorichi に戻します！
      revision: main       # ◀︎ main に戻します！
    - name: zmk-rgbled-widget
      remote: caksoylar
      revision: v0.3-branch
    - name: zmk-feature-charge-indicator
      remote: 4mplelab
      revision: main
  self:
    path: config
```
